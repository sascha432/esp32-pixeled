## components/board/Kconfig
```kconfig
menu "PixeLED board"

    choice PX_BOARD
        prompt "Board"
        help
            The board the firmware is built for. Each board's sdkconfig.defaults in boards/<name>/
            selects it, see docs/architecture.md section 8.

        config PX_BOARD_ESP32S3_DEVKIT
            bool "ESP32-S3-DevKitC-1 N16R8 (16 MB flash, 8 MB octal PSRAM)"
            depends on IDF_TARGET_ESP32S3

        config PX_BOARD_ESP32_DEVKIT
            bool "ESP32-DevKitC / WROOM-32 (4 MB flash, no PSRAM)"
            depends on IDF_TARGET_ESP32

        config PX_BOARD_ESP32C3_DEVKIT
            bool "ESP32-C3-DevKitM-1 (4 MB flash)"
            depends on IDF_TARGET_ESP32C3

        config PX_BOARD_ESP32C6_DEVKIT
            bool "ESP32-C6-DevKitC-1 (8 MB flash, 4 MB used)"
            depends on IDF_TARGET_ESP32C6
    endchoice

endmenu
```

## components/scripts/Kconfig
```kconfig
menu "PixeLED scripts"

    config PX_SCRIPTS
        bool "Glow scripts: animations written and run on the device"
        default y
        help
            Animations in the Glow language (docs/glow.md): written in the web UI, kept on
            LittleFS, compiled on the device and run by a small machine in the render task.
            Without it the firmware has none of it: no code, no RAM, no web page.

    config PX_SCRIPT_SLOTS
        int "Scripts at most"
        depends on PX_SCRIPTS
        range 1 16
        default 16
        help
            How many scripts the device keeps (their animation numbers 200 to 215). A script
            takes no RAM until it is shown: its record (152 bytes of /fs/scripts/index.bin), its
            source and its program are files, its style and sliders an NVS key of 18 bytes.

endmenu
```
